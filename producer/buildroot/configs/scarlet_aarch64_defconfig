## producer/buildroot/configs/scarlet_aarch64_defconfig
```kconfig
# Buildroot 2025.02.6 configuration for Scarlet aarch64.
#
# This preserves qemu_aarch64_virt_defconfig plus the project settings that
# were formerly applied by common_linux_userland.sh before make olddefconfig.
BR2_aarch64=y
BR2_PACKAGE_HOST_LINUX_HEADERS_CUSTOM_6_12=y
BR2_GLOBAL_PATCH_DIR="board/qemu/patches"
BR2_DOWNLOAD_FORCE_CHECK_HASHES=y
BR2_SYSTEM_DHCP="eth0"
BR2_ROOTFS_POST_IMAGE_SCRIPT=""
BR2_ROOTFS_POST_SCRIPT_ARGS=""
# BR2_LINUX_KERNEL is not set
# BR2_TARGET_ROOTFS_EXT2 is not set
BR2_TARGET_ROOTFS_TAR=y
# BR2_PACKAGE_HOST_QEMU is not set
# BR2_PACKAGE_HOST_QEMU_SYSTEM_MODE is not set

BR2_TOOLCHAIN_BUILDROOT_MUSL=y
BR2_TOOLCHAIN_BUILDROOT_CXX=y
BR2_GCC_VERSION_13_X=y
# BR2_GCC_VERSION_14_X is not set
BR2_ROOTFS_DEVICE_CREATION_DYNAMIC_EUDEV=y
BR2_PACKAGE_CAIRO=y
BR2_PACKAGE_CAIRO_PNG=y
BR2_PACKAGE_CAIRO_ZLIB=y
BR2_PACKAGE_DBUS=y
BR2_PACKAGE_DESKTOP_FILE_UTILS=y
BR2_PACKAGE_EUDEV=y
BR2_PACKAGE_EUDEV_MODULE_LOADING=y
BR2_PACKAGE_EUDEV_ENABLE_HWDB=y
BR2_PACKAGE_FILE=y
BR2_PACKAGE_GUMBO_PARSER=y
BR2_PACKAGE_HICOLOR_ICON_THEME=y
BR2_PACKAGE_JBIG2DEC=y
BR2_PACKAGE_JSON_GLIB=y
BR2_PACKAGE_JPEG=y
# BR2_PACKAGE_JPEG_TURBO is not set
BR2_PACKAGE_LCMS2=y
BR2_PACKAGE_LIBERATION=y
BR2_PACKAGE_LIBERATION_MONO=y
BR2_PACKAGE_LIBERATION_SANS=y
BR2_PACKAGE_LIBERATION_SERIF=y
BR2_PACKAGE_LIBEVDEV=y
BR2_PACKAGE_LIBGLIB2=y
BR2_PACKAGE_LIBGTK3=y
BR2_PACKAGE_LIBGTK3_WAYLAND=y
BR2_PACKAGE_LIBGTK3_DEMO=y
# BR2_PACKAGE_LIBGTK3_BROADWAY is not set
BR2_PACKAGE_LIBGTK4=y
BR2_PACKAGE_LIBGTK4_WAYLAND=y
BR2_PACKAGE_LIBGTK4_DEMO=y
# BR2_PACKAGE_LIBGTK4_BROADWAY is not set
BR2_PACKAGE_LIBINPUT=y
BR2_PACKAGE_LIBJPEG=y
BR2_PACKAGE_LIBPCIACCESS=y
BR2_PACKAGE_LIBSHA1=y
BR2_PACKAGE_LIBTIRPC=y
BR2_PACKAGE_LTRIS=y
# BR2_PACKAGE_LTRIS_AUDIO is not set
BR2_PACKAGE_LUA=y
BR2_PACKAGE_LUA_5_4=y
BR2_PACKAGE_MESA3D=y
BR2_PACKAGE_MESA3D_DEMOS=y
BR2_PACKAGE_MESA3D_GALLIUM_DRIVER_SWRAST=y
BR2_PACKAGE_MESA3D_GBM=y
BR2_PACKAGE_MESA3D_LLVM=y
BR2_PACKAGE_MESA3D_OPENGL_EGL=y
BR2_PACKAGE_MESA3D_OPENGL_ES=y
BR2_PACKAGE_MICROPYTHON=y
BR2_PACKAGE_MTDEV=y
BR2_PACKAGE_NANO=y
BR2_PACKAGE_NANO_TINY=y
BR2_PACKAGE_OPENJPEG=y
BR2_PACKAGE_POPPLER=y
BR2_PACKAGE_POPPLER_QT5=y
BR2_PACKAGE_QT5=y
BR2_PACKAGE_QT5BASE=y
BR2_PACKAGE_QT5BASE_EXAMPLES=y
BR2_PACKAGE_QT5BASE_GUI=y
BR2_PACKAGE_QT5BASE_LINUXFB=y
BR2_PACKAGE_QT5BASE_NETWORK=y
BR2_PACKAGE_QT5BASE_PRINTSUPPORT=y
BR2_PACKAGE_QT5BASE_TEST=y
BR2_PACKAGE_QT5BASE_WIDGETS=y
BR2_PACKAGE_QT5BASE_XML=y
BR2_PACKAGE_QT5WAYLAND=y
BR2_PACKAGE_SDL=y
BR2_PACKAGE_SDL_FBCON=y
# BR2_PACKAGE_SDL_MIXER is not set
BR2_PACKAGE_SEATD=y
BR2_PACKAGE_SEATD_BUILTIN=y
BR2_PACKAGE_SHARED_MIME_INFO=y
BR2_PACKAGE_SL=y
BR2_PACKAGE_SQLITE=y
BR2_PACKAGE_TIFF=y
BR2_PACKAGE_TIFF_CCITT=y
BR2_PACKAGE_TIFF_JPEG=y
BR2_PACKAGE_TIFF_LOGLUV=y
BR2_PACKAGE_TIFF_LZW=y
BR2_PACKAGE_TIFF_MDI=y
BR2_PACKAGE_TIFF_NEXT=y
BR2_PACKAGE_TIFF_OLD_JPEG=y
BR2_PACKAGE_TIFF_PACKBITS=y
BR2_PACKAGE_TIFF_PIXARLOG=y
BR2_PACKAGE_TIFF_THUNDER=y
BR2_PACKAGE_TIFF_ZLIB=y
BR2_PACKAGE_WAYLAND=y
BR2_PACKAGE_WAYLAND_PROTOCOLS=y
BR2_PACKAGE_WESTON=y
BR2_PACKAGE_WESTON_DEFAULT_HEADLESS=y
BR2_PACKAGE_WESTON_DEMO_CLIENTS=y
BR2_PACKAGE_WESTON_HEADLESS=y
BR2_PACKAGE_WESTON_SHELL_DESKTOP=y
# BR2_PACKAGE_WESTON_SHELL_FULLSCREEN is not set
# BR2_PACKAGE_WESTON_SHELL_IVI is not set
# BR2_PACKAGE_WESTON_SHELL_KIOSK is not set
# BR2_PACKAGE_WESTON_SCREENSHARE is not set
BR2_PACKAGE_WESTON_SIMPLE_CLIENTS=y
BR2_PACKAGE_XKEYBOARD_CONFIG=y
BR2_PACKAGE_WESTON_DEFAULT_COMPOSITOR="headless"
```
